## fs/accessfs/Kconfig
```kconfig
config ACCESS_FS
	tristate "Accessfs support (EXPERIMENTAL)"
	default n
	help
	  This is a new file system to manage permissions. It is not very
	  useful on its own. You need to enable other options below.

	  If you're unsure, say N.

config ACCESSFS_USER_PORTS
	tristate "User permission based IP ports"
	depends on ACCESS_FS && INET
	select NET_HOOKS
	default n
	help
	  If you say Y here, you will be able to control access to IP ports
	  based on user-/groupid.

	  If you're unsure, say N.

config ACCESSFS_PROT_SOCK
	int "Range of protected ports (1024-65536)"
	depends on ACCESSFS_USER_PORTS
	default 1024
	help
	  Here you can extend the range of protected ports. This is
	  from 1-1023 inclusive on normal unix systems. One use for this
	  could be to reserve ports for X11 (port 6000) or database
	  servers (port 3306 for mysql), so nobody else could grab this port.
	  The default permission for extended ports is --x--x--x.

	  If you build this as a module, you can specify the range of
	  protected ports at module load time (max_prot_sock).

	  If you're unsure, say 1024.

config ACCESSFS_IGNORE_NET_BIND_SERVICE
	bool "Ignore CAP_NET_BIND_SERVICE capability"
	depends on ACCESSFS_USER_PORTS
	default n
	help
	  This option lets you decide, wether a user with 
	  CAP_NET_BIND_SERVICE capability is able to override
	  your userport configuration.

	  If you build this as a module, you can specify this
	  option at module load time (ignore_net_bind_service).

	  If you're unsure, say N.

config ACCESSFS_USER_CAPABILITIES
	tristate "User permission based capabilities"
	depends on ACCESS_FS
	select SECURITY
	default n
	help
	  If you say Y here, you will be able to grant capabilities based on
	  user-/groupid (root by default). For this to work, you must say M or
	  N to CONFIG_SECURITY_CAPABILITIES.

	  If you're unsure, say N.
```
